## linux/br2-external/Config.in
```kconfig
menu "Tiny Tapeout RISC-V example programs (installed in /root)"
source "$BR2_EXTERNAL_TT_RISCV_PATH/package/tt-hello-7seg/Config.in"
source "$BR2_EXTERNAL_TT_RISCV_PATH/package/tt-rust-nostd/Config.in"
source "$BR2_EXTERNAL_TT_RISCV_PATH/package/tt-rust-std/Config.in"
endmenu
```

## linux/br2-external/package/tt-hello-7seg/Config.in
```kconfig
config BR2_PACKAGE_TT_HELLO_7SEG
	bool "hello_7seg"
	default y
	help
	  HELLO then 0-9 on the demo board's 7-segment display, through the
	  KianV GPIO registers. Source: linux/apps/hello-7seg.
```

## linux/br2-external/package/tt-rust-nostd/Config.in
```kconfig
config BR2_PACKAGE_TT_RUST_NOSTD
	bool "rust_nostd_hello"
	default y
	help
	  no_std Rust userspace demo. Needs rustup with a nightly toolchain
	  and rust-src on the build machine (skipped with a warning without
	  cargo). Source: linux/apps/rust-nostd.
```

## linux/br2-external/package/tt-rust-std/Config.in
```kconfig
config BR2_PACKAGE_TT_RUST_STD
	bool "rust_std_hello, rust_std_demo (experimental)"
	default y
	help
	  Rust programs using the full standard library, with a custom
	  target, patched libc/std and a pthread shim. Needs rustup with a
	  nightly toolchain and rust-src, and network access to crates.io
	  (skipped with a warning without cargo). Source: linux/apps/rust-std.
```
